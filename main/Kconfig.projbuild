## main/Kconfig.projbuild
```kconfig
menu "E-piano"
config EPIANO_RHODES_VOICES
    int "Physical Rhodes voice limit"
    range 1 8
    default 8
    help
        Other presets retain 16 voices. The optimized physical engine has
        been profiled with up to eight simultaneous voices.
config EPIANO_RHODES_STRESS
    bool "Run physical Rhodes profiling sequence at startup"
    default n
    help
        Runs all three Rhodes presets with 8 voices across five registers.
        Includes hard simultaneous attacks, sustain, low/high registers and
        fast retriggers. May underrun until performance is validated.
endmenu
```

## sdkconfig.defaults
```kconfig
# Freenove ESP32-S3 (16MB Flash)
CONFIG_IDF_TARGET="esp32s3"
CONFIG_ESPTOOLPY_FLASHSIZE_16MB=y
CONFIG_ESP_DEFAULT_CPU_FREQ_MHZ_240=y
CONFIG_FREERTOS_HZ=1000
CONFIG_COMPILER_OPTIMIZATION_PERF=y

# 電源投入直後の MIDI 鍵盤が準備できるまで待ってから列挙する
CONFIG_USB_HOST_DEBOUNCE_DELAY_MS=1000
```
